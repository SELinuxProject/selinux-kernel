## security/selinux/Kconfig
```kconfig
# SPDX-License-Identifier: GPL-2.0-only
config SECURITY_SELINUX
	bool "SELinux Support"
	depends on SECURITY_NETWORK && AUDIT && NET && INET
	select NETWORK_SECMARK
	default n
	help
	  This selects Security-Enhanced Linux (SELinux).
	  You will also need a policy configuration and a labeled filesystem.
	  If you are unsure how to answer this question, answer N.

config SECURITY_SELINUX_BOOTPARAM
	bool "SELinux boot parameter"
	depends on SECURITY_SELINUX
	default n
	help
	  This option adds a kernel parameter 'selinux', which allows SELinux
	  to be disabled at boot.  If this option is selected, SELinux
	  functionality can be disabled with selinux=0 on the kernel
	  command line.  The purpose of this option is to allow a single
	  kernel image to be distributed with SELinux built in, but not
	  necessarily enabled.

	  If you are unsure how to answer this question, answer N.

config SECURITY_SELINUX_DEVELOP
	bool "SELinux Development Support"
	depends on SECURITY_SELINUX
	default y
	help
	  This enables the development support option of SELinux,
	  which is useful for experimenting with SELinux and developing
	  policies.  If unsure, say Y.  With this option enabled, the
	  kernel will start in permissive mode (log everything, deny nothing)
	  unless you specify enforcing=1 on the kernel command line.  You
	  can interactively toggle the kernel between enforcing mode and
	  permissive mode (if permitted by the policy) via
	  /sys/fs/selinux/enforce.

config SECURITY_SELINUX_AVC_STATS
	bool "SELinux AVC Statistics"
	depends on SECURITY_SELINUX
	default y
	help
	  This option collects access vector cache statistics to
	  /sys/fs/selinux/avc/cache_stats, which may be monitored via
	  tools such as avcstat.

config SECURITY_SELINUX_SIDTAB_HASH_BITS
	int "SELinux sidtab hashtable size"
	depends on SECURITY_SELINUX
	range 8 13
	default 9
	help
	  This option sets the number of buckets used in the sidtab hashtable
	  to 2^SECURITY_SELINUX_SIDTAB_HASH_BITS buckets. The number of hash
	  collisions may be viewed at /sys/fs/selinux/ss/sidtab_hash_stats. If
	  chain lengths are high (e.g. > 20) then selecting a higher value here
	  will ensure that lookups times are short and stable.

config SECURITY_SELINUX_SID2STR_CACHE_SIZE
	int "SELinux SID to context string translation cache size"
	depends on SECURITY_SELINUX
	default 256
	help
	  This option defines the size of the internal SID -> context string
	  cache, which improves the performance of context to string
	  conversion.  Setting this option to 0 disables the cache completely.

	  If unsure, keep the default value.

config SECURITY_SELINUX_DEBUG
	bool "SELinux kernel debugging support"
	depends on SECURITY_SELINUX
	default n
	help
	  This enables debugging code designed to help SELinux kernel
	  developers, unless you know what this does in the kernel code you
	  should leave this disabled.

	  To fine control the messages to be printed enable
	  CONFIG_DYNAMIC_DEBUG and see
	  Documentation/admin-guide/dynamic-debug-howto.rst for additional
	  information.

	  Example usage:

		echo -n 'file "security/selinux/*" +p' > \
			/proc/dynamic_debug/control

config SECURITY_SELINUX_NS
	bool "SELinux namespace support (experimental)"
	depends on SECURITY_SELINUX
	default n
	help
	  This enables (experimental) support for SELinux namespaces,
	  i.e the ability to create multiple SELinux namespaces where
	  each namespace has its own independent enforcing mode,
	  AVC, and policy, accessible through its own independent
	  selinuxfs instance. When a task unshares its SELinux namespace,
	  it is associated with a new child namespace whose initial
	  state is permissive with no policy loaded, and the task is assigned
	  a separate SID in the new namespace, initially the kernel SID,
	  which is likewise independent of its SID in ancestor namespaces.
	  Subsequent actions by the task and its descendants are checked
	  against the new namespace and all ancestor namespaces, using the
	  SID it has in each namespace for that namespace's checks. Objects
	  like inodes only have a single SID irrespective of the namespace
	  in which they are created or accessed. If the context associated
	  with a SID is not defined in a namespace, then it is treated as
	  the unlabeled SID for access checking purposes in that namespace.
	  The current kernel API for unsharing the SELinux namespace is to
	  write a "1" to /sys/fs/selinux/unshare; this is likely to change
	  before upstreaming. Experimental patches for libselinux and
	  systemd to use this support can be found in the selinuxns
	  branches of https://github.com/stephensmalley/selinux, which
	  provides a selinux_unshare() API that wraps the kernel interface,
	  and https://github.com/stephensmalley/systemd, which has
	  a modified systemd-nspawn that uses this API when called
	  with --selinux-namespace and a modified systemd to perform
	  SELinux initialization when started within a container that
	  has its own SELinux namespace. Userspace can also detect
	  whether it is running in a non-init SELinux namespace by
	  reading /sys/fs/selinux/unshare ("1" means it has been unshared,
	  "0" means it has not) but an API for this might not be retained.

config SECURITY_SELINUX_MAXNS
	int "SELinux default maximum number of namespaces"
	depends on SECURITY_SELINUX_NS
	range 1 65535
	default 65535
	help
	  This option sets the default maximum number of SELinux namespaces.
	  The value may be viewed or modified via /sys/fs/selinux/maxns.

config SECURITY_SELINUX_MAXNSDEPTH
	int "SELinux default maximum depth of namespaces"
	depends on SECURITY_SELINUX_NS
	range 0 32
	default 32
	help
	  This option sets the default maximum depth of SELinux namespaces.
	  The value may be viewed or modified via /sys/fs/selinux/maxnsdepth.
```
